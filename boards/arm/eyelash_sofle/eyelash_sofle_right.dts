/*
*
* Copyright (c) 2021 Darryl deHaan
* SPDX-License-Identifier: MIT
*
*/
#include "eyelash_sofle.dtsi"

&kscan0 {
     col-gpios =
        <&gpio0 29 (GPIO_ACTIVE_HIGH | GPIO_PULL_DOWN)>;   /* Col 1 GPIO 029 */
        <&gpio0 2 (GPIO_ACTIVE_HIGH | GPIO_PULL_DOWN)>,    /* Col 2 GPIO 002 */
        <&gpio1 15 (GPIO_ACTIVE_HIGH | GPIO_PULL_DOWN)>,  /* Col 3 GPIO 115 */
        <&gpio1 13 (GPIO_ACTIVE_HIGH | GPIO_PULL_DOWN)>,  /* Col 4 GPIO 113 */
        <&gpio1 11 (GPIO_ACTIVE_HIGH | GPIO_PULL_DOWN)>,  /* Col 5 GPIO 111 */
        <&gpio0 10 (GPIO_ACTIVE_HIGH | GPIO_PULL_DOWN)>,   /* Col 6 GPIO 010 */
        <&gpio0 9 (GPIO_ACTIVE_HIGH | GPIO_PULL_DOWN)>,  /* Col 7 GPIO 009 */
};

&default_transform {
    col-offset = <7>;
};

